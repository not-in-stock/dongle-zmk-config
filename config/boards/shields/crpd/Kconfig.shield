## config/boards/shields/crpd/Kconfig.shield
```kconfig
config SHIELD_CRPD_DONGLE
    def_bool $(shields_list_contains,crpd_dongle)

config SHIELD_CRPD_CENTRAL_LEFT
    def_bool $(shields_list_contains,crpd_central_left)

config SHIELD_CRPD_P_LEFT
    def_bool $(shields_list_contains,crpd_p_left)

config SHIELD_CRPD_P_RIGHT
    def_bool $(shields_list_contains,crpd_p_right)
```
